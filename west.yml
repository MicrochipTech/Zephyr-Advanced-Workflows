## west.yml
```yaml
manifest:
  defaults:
      remote: local-repos

  remotes:
    - name: local-repos
      # CRITICAL: This path assumes the student copies 'lab1_start' 
      # to a folder that is peer to 'cache'. 
      # If that's hard to guarantee, use absolute path: 'file:///D:/cache'
      url-base: file://C:/Developers/ZAW/repos

    - name: zephyr-upstream
      url-base: https://github.com/zephyrproject-rtos

  projects:
    - name: zephyr
      remote: local-repos
      revision: v4.4.0  # Or a specific tag like v3.5.0
      import: 
        name-allowlist:
          - cmsis

    - name: hal_microchip
      remote: local-repos
      revision: 86f3ea6b389d860332bd81ae8b97543def619395 
      path: modules/hal/microchip
      groups:
        - hal

    - name: cmsis
      remote: local-repos
      revision: 512cc7e895e8491696b61f7ba8066b4a182569b8
      path: modules/hal/cmsis

    - name: cmsis_6
      remote: local-repos
      revision: 30a859f44ef8ab4dc8f84b03ed586fd16ccf9d74
      path: modules/hal/cmsis_6
      groups:
        - hal

  self:
    path: app
```
